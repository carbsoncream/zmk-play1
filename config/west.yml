## config/west.yml
```yaml
manifest:
  remotes:
    - name: zmkfirmware
      url-base: https://github.com/petejohanson
    - name: gpeye
      url-base: https://github.com/GPeye
    - name: urob
      url-base: https://github.com/urob
  projects:
    - name: zmk
      remote: zmkfirmware
      revision: feat/pointers-move-scroll
      import: app/west.yml
    - name: urchin-peripheral-animation
      remote: gpeye
      revision: main 
    - name: zmk-helpers
      remote: urob
      revision: main
  self:
    path: config
```
